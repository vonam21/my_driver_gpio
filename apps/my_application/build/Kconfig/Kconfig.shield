## apps/my_application/build/Kconfig/Kconfig.shield
```kconfig
osource "D:/Desktop/source/my_driver_gpio/apps/my_application/../..//boards/shields/*/Kconfig.shield"
```

## drivers/dts/bindings/funny_driver_name/zephyr,vo-khac-nam.yaml
```yaml
description: |
    An example sensor that reads the GPIO level defined in input-gpios.

compatible: "zephyr,vo-khac-nam"
properties:
    gpios:
        type: phandle-array
        required: true
        description: |
            Input gpios.
include: base.yaml
```

## drivers/gpio_driver/Kconfig
```kconfig
menuconfig GPIO 
    bool "This is my driver gpio"
    help 
        this is my driver gpio 

config CHOSEN_GPIO
    bool "chosen_gpio"
    default y 
    depends on DT_HAS_ZEPHYR_VO_KHAC_NAM_ENABLED
    help 
        Select this to is gpio driver
    
```
